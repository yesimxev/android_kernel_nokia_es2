## drivers/input/fingerprint/fih/Kconfig
```kconfig
#
# Configuration for FIH
#

config FIH_FINGERPRINT
	bool "FIH Fingerprint Driver"
	default n
	---help---
	  This is a FIH fingerprint chipset Driver.
```

## drivers/input/touchscreen/mediatek/focaltech_touch_ft8613/Kconfig
```kconfig
#
# Touchscreen driver configuration
#
config TOUCHSCREEN_MTK_FOCALTECH_TS
    bool "Focaltech Ts for Mediatek"
    depends on I2C
    default n
    help
      Say Y here if you have Focaltech touch panel.
      If unsure, say N.

config TOUCHSCREEN_MTK_FTS_DIRECTORY
    string "Focaltech ts directory name"
    default "focaltech_touch"
    depends on TOUCHSCREEN_MTK_FOCALTECH_TS

config TOUCHSCREEN_FOCALTECH_TS_DEBUG
    bool "Focaltech Ts for Debug"
    depends on TOUCHSCREEN_MTK_FOCALTECH_TS
    default n
    help
      Say Y here if you want to debug Focaltech touch panel
      If unsure, say N.
```

## drivers/input/touchscreen/mediatek/nt36672/Kconfig
```kconfig
#
# Novatek NT36xxx touchscreen driver configuration
#


config TOUCHSCREEN_NT36xxx
	bool "Novatek NT36xxx"
	default n
	help
	  Say Y here if you have a Novatek NT36xxx touchscreen connected
	  to your system.

	  If unsure, say N.

config GTP_USE_PMIC_DETECT_USB_PLUGIN
	bool "GTP_USE_PMIC_DETECT_USB_PLUGIN"
	default n
	help
	Say Y here if you have touch panel use mtk pmic to enbale
	the charger(default N is use work queue to check).

	If unsure, say N.
```

## drivers/misc/mediatek/hall-switch/Kconfig
```kconfig
config MTK_HALL_SWITCH
	tristate "MediaTek HALL driver"
	default n
	---help---
	  If unsure, say N.
```

## drivers/misc/mediatek/hallsensor/Kconfig
```kconfig
config MTK_HALL_SENSOR
	tristate "MediaTek HALL driver"
	default n
	---help---
	  If unsure, say N.
```

## drivers/misc/mediatek/nfc/Kconfig
```kconfig
menuconfig MTK_NFC
	tristate "NFC drivers"
	depends on !MTK_ENABLE_GMO
	default n
	---help---
	  Say Y here for supporting NFC.
	  Say Y here for supporting NFC.
	  Say Y here for supporting NFC.

if MTK_NFC

config NFC_MT6605 # MTK_NFC
	tristate "MediaTek NFC driver"
	depends on !MTK_ENABLE_GMO
	default n
	help
	  Y means NFC_MT6605 define if use Mediatek NFC Function to provide reader
	  Card emulation or P2P function. If you are not sure about this, set n.
	  Y means NFC_MT6605 define if use Mediatek NFC Function to provide reader
	  Card emulation or P2P function. If you are not sure about this, set n.

config NFC_MSR3110
	tristate "MSR3110 NFC driver"
	default n
	help
	  Y means NFC_MSR3110 define if use MSTAR NFC Function to provide reader
	  Card emulation or P2P function. If you are not sure about this, set n.

endif # NFC

config STM_MTK_NFC
	tristate "NFC driver solution - STMicroelectronics ST21NFC NFC Controller Driver"
	default n
	depends on I2C
	help
	  STMicroelectronics ST21NFC Near Field Communication controller support.
	  ST21NFCD can support 2UICC mode, and ST54F can support 1UICC + eSE.
	  If configures to be y, means devices supports NFC functionality.
	  If configures to be n, means devices doesn't support NFC functionality.
```

## drivers/misc/mediatek/sensors-1.0/alsps/ltr559/Kconfig
```kconfig
config MTK_LTR559
	bool "LTR556 for MediaTek package"
	default n

config MTK_ALSPS_ES2
	bool "LTR556 for MediaTek package"
	default n

config MTK_ALSPS_CO2
	bool "LTR556 for MediaTek package"
	default n
```
